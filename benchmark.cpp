#include <cinttypes>
#include <cstdint>
#if defined(ESP32)
#include <esp_task_wdt.h>
#endif

#include "bus.h"


constexpr const uint8_t benchmark_raw[] = {
  0xc6, 0x15, 0x00, 0x02, 0x77, 0x00, 0xa2, 0x00, 0x00, 0x00, 0x00, 0x00,
  0x00, 0x00, 0x00, 0x00, 0x00, 0x00, 0x00, 0x00, 0x00, 0x00, 0x00, 0x00,
  0x00, 0x00, 0x00, 0x00, 0x00, 0x00, 0x00, 0x00, 0x00, 0x00, 0x00, 0x00,
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  0x87, 0x00
};
constexpr const size_t  benchmark_raw_len { 614 };

constexpr const uint8_t benchmark_w_mmu_raw[] = {
  0xc6, 0x15, 0x00, 0x02, 0x77, 0x00, 0xa2, 0x00, 0x00, 0x00, 0x00, 0x00,
  0x00, 0x00, 0x00, 0x00, 0x00, 0x00, 0x00, 0x00, 0x00, 0x00, 0x00, 0x00,
  0x00, 0x00, 0x00, 0x00, 0x00, 0x00, 0x00, 0x00, 0x00, 0x00, 0x00, 0x00,
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  0x37, 0x90, 0x36, 0xfa, 0x82, 0x0a, 0xf7, 0x01, 0x87, 0x00
};

constexpr const size_t benchmark_w_mmu_raw_len = 838;


constexpr const uint16_t base { 01000 };

uint64_t get_count(bus *const b)
{
	// NOTE: these locations depend on the version of benchmark.asm!
	uint64_t count = 0;
	for(int i=5; i>=0; i--) {
		count <<= 8;
		count |= b->read_byte(base + 8 + i);
	}
	return count;
}

void reset_benchmark(bus *const b, const bool with_mmu)
{
        cpu *const c = b->getCpu();
	c->reset();
	b->reset(true);

	if (with_mmu) {
		for(uint16_t a = 0; a<benchmark_w_mmu_raw_len; a++)
			b->write_byte(a + base, benchmark_w_mmu_raw[a]);
	}
	else {
		for(uint16_t a = 0; a<benchmark_raw_len; a++)
			b->write_byte(a + base, benchmark_raw[a]);
	}

        c->set_register(7, base);
}

void benchmark(console *const cnsl, bus *const b, kek_event_t *const stop_event, const bool verbose, const bool with_mmu)
{
	cnsl->put_string_lf(format("verbose: %d, with mmu: %d", verbose, with_mmu));

        reset_benchmark(b, with_mmu);

        cpu *const c = b->getCpu();

	*stop_event = EVENT_NONE;

	if (verbose) {
		cnsl->put_string_lf("please wait ~20 seconds");
		uint64_t start_ts1    = get_us();
		size_t   cycle_count  = 0;
		uint64_t duration     = 0;
		while(load_relaxed_p(stop_event) == EVENT_NONE) {
			uint16_t pc = c->getPC();
			cycle_count++;
			// c->step() may alter what is beneath pc, so this first
			duration += c->calc_instruction_duration(pc);
			c->step();
		}
		uint64_t end_ts1      = get_us();

		double   timing_comp1 = 10000000. / (end_ts1 - start_ts1);  // kw11-l interrupt is not always exact 50 Hz
		uint64_t count_slower = get_count(b) * timing_comp1;

		reset_benchmark(b, with_mmu);

		uint64_t start_ts2    = get_us();
		*stop_event = EVENT_NONE;
		while(load_relaxed_p(stop_event) == EVENT_NONE)
			c->step();
		uint64_t end_ts2      = get_us();

		double   timing_comp2 = 10000000. / (end_ts2 - start_ts2);
		uint64_t count_faster = get_count(b) * timing_comp2;

		double   mul          = count_faster / double(count_slower);

#if defined(TEENSY4_1)
		cnsl->put_string_lf(format("benchmark count slow: %" PRIzu " (%.3f timer jitter compensation), count fast: %" PRIzu " (%.3f)", size_t(count_slower), timing_comp1, size_t(count_faster), timing_comp2));
		cnsl->put_string_lf(format("benchmark (raw): %" PRIzu " instructions, emulated duration: %.3f seconds", cycle_count, duration / 1000000000.));
		cnsl->put_string_lf(format("benchmark (compensated): %" PRIzu " instructions, emulated duration: %.3f seconds", size_t(cycle_count * mul), duration * mul / 1000000000.));
#else
		cnsl->put_string_lf(format("benchmark count slow: %" PRIu64 " (%.3f timer jitter compensation), count fast: %" PRIu64 " (%.3f)", count_slower, timing_comp1, count_faster, timing_comp2));
		cnsl->put_string_lf(format("benchmark (raw): %" PRIzu " instructions, emulated duration: %.3f seconds (or %" PRIu64 " ns)", cycle_count, duration / 1000000000., duration));
		cnsl->put_string_lf(format("benchmark (compensated): %" PRIzu " instructions, emulated duration: %.3f seconds (or %" PRIu64 " ns)", size_t(cycle_count * mul), duration * mul / 1000000000., uint64_t(duration * mul)));
#endif
	}
	else {
		cnsl->put_string_lf("please wait ~10 seconds");
		while(load_relaxed_p(stop_event) == EVENT_NONE)
			c->step();
	}
}
